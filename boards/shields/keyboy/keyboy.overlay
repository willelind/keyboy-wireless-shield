/ {
    chosen {
        zmk,kscan = &kscan0;
    };

    kscan0: kscan_0 {
        compatible = "zmk,kscan-gpio-direct";

        input-gpios
            = <&pro_micro 1 (GPIO_ACTIVE_LOW | GPIO_PULL_UP)>
            , <&pro_micro 0 (GPIO_ACTIVE_LOW | GPIO_PULL_UP)>
            , <&pro_micro 2 (GPIO_ACTIVE_LOW | GPIO_PULL_UP)>
            , <&pro_micro 3 (GPIO_ACTIVE_LOW | GPIO_PULL_UP)>
            ;
    };
};
